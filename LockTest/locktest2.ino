/*

ESP32 (Feather/Wroom)
Checks fingerprint from enrollment + displays if correct
Author: Alex Jain <ajain@pdx.edu>
Date: Nov 5th, 2024
Version: 0.1

Necessary Libraries:
1: https://github.com/adafruit/Adafruit-Fingerprint-Sensor-Library
2: https://github.com/adafruit/Adafruit-GFX-Library
3: https://github.com/sumotoy/TFT_ILI9163C
4: 

*/

// Library Headers
#include <SPI.h>
#include <Adafruit_GFX.h>
#include <TFT_ILI9163C.h>
#include <Adafruit_Fingerprint.h>
#include <SoftwareSerial.h>

/* TFT Display Setup */
// Colors
#define BLACK   0x0000
#define BLUE    0x001F
#define RED     0xF800
#define GREEN   0x07E0
#define CYAN    0x07FF
#define MAGENTA 0xF81F
#define YELLOW  0xFFE0  
#define WHITE   0xFFFF

// Pin Definitions
#define __CS 13 // Define CS pin as GPIO 13
#define __DC 12 // Define RST pin as GPIO 12
#define A0 26   // Define A0 as Pin 26
#define RX_PIN 16 // Green wire from sensor (Data Out - TD)
#define TX_PIN 17 // White wire from sensor (Data In - RD)
// Note: SDA is Pin 23, SCK is Pin 22

// PROGMEM
static const uint8_t icon [] PROGMEM = {
0x0,0x0,0x0,0x0,0x0,0x0,0x0,0x0,
0x0,0x0,0x0,0x0,0x0,0x0,0x0,0x0,
0x0,0x0,0x0,0x0,0x0,0x0,0x0,0x0,
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0x0,0x0,0x0,0x0,0x0,0x0,0x0,0x0
};

// Setup Display & Serial
TFT_ILI9163C display = TFT_ILI9163C(__CS, A0, __DC);
HardwareSerial mySerial(1); 
Adafruit_Fingerprint finger = Adafruit_Fingerprint(&mySerial);
int fingerprintID = 0;

void setup() {

  // Initialize Serial1 on defined RX/TX with baud rate of 57600
  mySerial.begin(57600, SERIAL_8N1, RX_PIN, TX_PIN);

  startFingerprintSensor();
  display.begin();
  displayLockScreen();

}

// Main loop to check if authorized users
void loop() {
  
  fingerprintID = getFingerprintID();
  delay(50); // Check every 50 ms
  if (fingerprintID == 1) { // If authorized fingerprint
    display.drawBitmap(30,35,icon,60,60,GREEN);
    delay(200);
    displayUnlockedScreen();
    displayAuthorized();
    delay(5000); // Wait 5 seconds before going back to lockscreen
    display.fillScreen(BLACK);
    displayLockScreen();
  }

}

// Function for Unlocked Screen
void displayUnlockedScreen() {

  display.fillScreen(BLACK);
  display.drawRect(0,0,128,128,WHITE);
  display.setCursor(18,10);
  display.setTextColor(GREEN);
  display.setTextSize(2);
  display.print("UNLOCKED");
  display.setCursor(20,50);
  display.setTextColor(WHITE);
  display.setTextSize(2);
  display.print("TREASURE IS YOURS!");
  Serial.print("Congrats you win"); // Testing, remove later.

}

// Function for Authorized Fingerprint detected
void displayAuthorized() {

  display.setCursor(35,75);
  display.setTextColor(WHITE);
  display.setTextSize(1);
  display.print("Authorized User Detected");
  Serial.print("Successful User"); // Testing, remove later.

}

// Function for Lock Screen
void displayLockScreen() {

  display.drawRect(0,0,128,128,WHITE);
  display.setCursor(30,10);
  display.setTextColor(RED);
  display.setTextSize(2);
  display.print("LOCKED");
  display.setCursor(10,100);
  display.setTextColor(WHITE);
  display.setTextSize(1);
  display.print("Waiting for authorized \n    user.");
  Serial.print("Waiting for authorized fingerprint"); // Testing, remove later.
  display.drawBitmap(30,35,icon,60,60,WHITE);

}

// Function to initialize R307 Fingerprint Sensor
void startFingerprintSensor() {

  Serial.begin(9600);
  finger.begin(57600);

  if (finger.verifyPassword()) { // See if sensor exists
    Serial.println("Found Sensor"); 
  } else {
    Serial.println("Sensor not found");
  }
  Serial.println("Waiting for valid finger...");

}

// Function for obtaining fingerprint ID
int getFingerprintID() {

  uint8_t p = finger.getImage(); // Return error if false
  if (p != FINGERPRINT_OK)  return -1;

  p = finger.image2Tz(); // Return error if false
  if (p != FINGERPRINT_OK)  return -1;

  p = finger.fingerFastSearch(); // Return error if false
  if (p != FINGERPRINT_OK)  return -1;
  
  // Found matching fingerprint from data.
  Serial.print("Found ID #"); Serial.print(finger.fingerID); 
  Serial.print(" with confidence of "); Serial.println(finger.confidence);
  return finger.fingerID; 

}
