/* 
ESP32 (Wroom)
Checks fingerprint from enrollment + displays if correct
Author: Alex Jain <ajain@pdx.edu>, Anthony Le <anthle@pdx.edu)
Date: Nov 18th, 2024
Version: 0.2

Necessary Libraries:
1: https://github.com/adafruit/Adafruit-Fingerprint-Sensor-Library
2: https://github.com/adafruit/Adafruit-GFX-Library
3: https://github.com/sumotoy/TFT_ILI9163C (download this zip file from git then [sketch -> include .zip])
4: Use ESP32 Dev Module
*/

// Library Headers
#include <SPI.h>
#include <Adafruit_GFX.h>
#include <HardwareSerial.h>
#include <Adafruit_Fingerprint.h>
#include <TFT_ILI9163C.h> // Change offset to 0 by going to _settings/TFT_ILI9163C_settings.h

// Pin Definitions (Adjust based on ESP32 WROOM pinout)
#define __CS 15     // Chip Select for TFT as GPIO 15 (Connect to TFT CS pin)
#define __DC 2      // Data/Command for TFT as GPIO 2 (Connect to TFT DC or A0 pin)
#define A0 4        // Reset for TFT as Pin 26 (Connect to TFT RESET pin)
#define SCK 18      // Clock for TFT as Pin 22 (Connect to TFT SCK pin)
#define RX_PIN 16   // RX2 on ESP32 for fingerprint sensor (Connect Green wire from TD pin of fingerprint sensor)
#define TX_PIN 17   // TX2 on ESP32 for fingerprint sensor (Connect White wire from RD pin of fingerprint sensor)
// Note: SDA is Pin 23, SCK is Pin 22

// Color definitions for TFT display
#define BLACK   0x0000
#define BLUE    0x001F
#define RED     0xF800
#define GREEN   0x07E0
#define CYAN    0x07FF
#define MAGENTA 0xF81F
#define YELLOW  0xFFE0  
#define WHITE   0xFFFF

// // PROGMEM
// static const uint8_t icon [] PROGMEM = {
// 0x0,0x0,0x0,0x0,0x0,0x0,0x0,0x0,
// 0x0,0x0,0x0,0x0,0x0,0x0,0x0,0x0,
// 0x0,0x0,0x0,0x0,0x0,0x0,0x0,0x0,
// 0x0,0x0,0x0,0x3f,0xc0,0x0,0x0,0x0,
// 0x0,0x0,0x3,0xff,0xf8,0x0,0x0,0x0,
// 0x0,0x0,0x7,0xff,0xfe,0x0,0x0,0x0,
// 0x0,0x0,0x1f,0xc0,0x7f,0x80,0x0,0x0,
// 0x0,0x0,0x3e,0x0,0x7,0xc0,0x0,0x0,
// 0x0,0x0,0x7c,0x0,0x3,0xe0,0x0,0x0,
// 0x0,0x0,0xfd,0xff,0x81,0xf0,0x0,0x0,
// 0x0,0x0,0xff,0xff,0xe0,0xf0,0x0,0x0,
// 0x0,0x1,0xff,0xff,0xf8,0x78,0x0,0x0,
// 0x0,0x1,0xff,0x80,0x7c,0x38,0x0,0x0,
// 0x0,0x3,0xfc,0x0,0xe,0x3c,0x0,0x0,
// 0x0,0x3,0xf0,0x0,0x7,0x1c,0x0,0x0,
// 0x0,0x7,0xc0,0x7f,0x83,0x8e,0x0,0x0,
// 0x0,0x7,0x83,0xff,0xe0,0xe,0x0,0x0,
// 0x0,0x7,0xf,0xff,0xf8,0xf,0x0,0x0,
// 0x0,0x6,0x1f,0x80,0xfc,0x7,0x0,0x0,
// 0x0,0x4,0x7e,0x0,0x3f,0x7,0x0,0x0,
// 0x0,0x0,0xf8,0x0,0xf,0x7,0x0,0x0,
// 0x0,0x0,0xf0,0x3e,0x7,0x87,0x0,0x0,
// 0x0,0x1,0xe1,0xff,0x83,0x83,0x80,0x0,
// 0x0,0x3,0xc3,0xff,0xc3,0xc3,0x80,0x0,
// 0x0,0x3,0xc7,0xc3,0xe1,0xc3,0x80,0x0,
// 0x0,0x3,0x8f,0x0,0xf1,0xe3,0x80,0x0,
// 0x0,0x7,0x1e,0x0,0x78,0xe3,0x80,0x0,
// 0x0,0x7,0x1e,0x3c,0x38,0xe3,0x80,0x0,
// 0x0,0x7,0x1c,0x7e,0x38,0xe3,0x80,0x0,
// 0x0,0xf,0x1c,0x7f,0x38,0xe3,0x80,0x0,
// 0x0,0xe,0x3c,0xf7,0x38,0x71,0x80,0x0,
// 0x0,0xe,0x38,0xe7,0x38,0x71,0xc0,0x0,
// 0x0,0xe,0x38,0xe7,0x38,0x71,0xc0,0x0,
// 0x0,0xe,0x38,0xe7,0x38,0x73,0xc0,0x0,
// 0x0,0xe,0x38,0xe3,0x98,0xe3,0xc0,0x0,
// 0x0,0xe,0x38,0xe3,0xb8,0xe3,0x80,0x0,
// 0x0,0x0,0x38,0xe3,0xf8,0xe3,0x80,0x0,
// 0x0,0x0,0x38,0xe3,0xf8,0xe3,0x80,0x0,
// 0x0,0x0,0x3c,0xf1,0xf1,0xe3,0x80,0x0,
// 0x0,0x6,0x1c,0x70,0x1,0xc7,0x80,0x0,
// 0x0,0xe,0x1c,0x78,0x3,0xc7,0x80,0x0,
// 0x0,0xf,0x1c,0x3e,0x7,0x87,0x0,0x0,
// 0x0,0xf,0x1e,0x3f,0xff,0x8f,0x0,0x0,
// 0x0,0xf,0x1e,0x1f,0xff,0x1f,0x0,0x0,
// 0x0,0xf,0xf,0x7,0xfc,0x3e,0x0,0x0,
// 0x0,0x7,0x87,0x80,0x0,0x7c,0x0,0x0,
// 0x0,0x7,0x87,0xe0,0x0,0xfc,0x0,0x0,
// 0x0,0x3,0xc3,0xf8,0x7,0xf8,0x0,0x0,
// 0x0,0x3,0xe1,0xff,0xff,0xe1,0x0,0x0,
// 0x0,0x1,0xe0,0x7f,0xff,0x83,0x0,0x0,
// 0x0,0x1,0xf8,0xf,0xfe,0x7,0x0,0x0,
// 0x0,0x0,0xfc,0x0,0x0,0xe,0x0,0x0,
// 0x0,0x0,0x3f,0x0,0x0,0x3c,0x0,0x0,
// 0x0,0x0,0x1f,0xe0,0x1,0xf8,0x0,0x0,
// 0x0,0x0,0x7,0xff,0xff,0xf0,0x0,0x0,
// 0x0,0x0,0x1,0xff,0xff,0xc0,0x0,0x0,
// 0x0,0x0,0x0,0x1f,0xfc,0x0,0x0,0x0,
// 0x0,0x0,0x0,0x0,0x0,0x0,0x0,0x0,
// 0x0,0x0,0x0,0x0,0x0,0x0,0x0,0x0,
// 0x0,0x0,0x0,0x0,0x0,0x0,0x0,0x0
// };

// Instantiate objects
TFT_ILI9163C tft(__CS, __DC, A0); // TFT object
HardwareSerial mySerial(2);       // Serial2 for fingerprint sensor (UART)
Adafruit_Fingerprint finger = Adafruit_Fingerprint(&mySerial);

void setup() {
  Serial.begin(115200);
  mySerial.begin(57600, SERIAL_8N1, RX_PIN, TX_PIN); // Setup UART for fingerprint sensor

  // Initialize TFT
  tft.begin();
  // Draw the image on the screen
  delay(1000);
  tft.fillScreen(BLACK);
  tft.setRotation(2); // 2 faces towards pins, 4 faces away
  tft.setTextColor(WHITE);
  tft.setTextSize(2);

  tft.println(" \n\n Finger\n Print\n Demo");
  delay(2000);

  // Initialize fingerprint sensor
  if (finger.verifyPassword()) {
    Serial.println("Found fingerprint sensor!");
    tft.fillScreen(BLACK);
    delay(1000);
    tft.println(" \n Sensor\n Ready\n\n");
    delay(2000);
  } else {
    Serial.println("Fingerprint sensor not found!");
    tft.fillScreen(RED);
    delay(1000);
    tft.println(" \n Sensor\n Error");
    delay(1000);
    while (1); // Halt if fingerprint sensor is not found
  }
}

void loop() {
  tft.fillScreen(BLACK);
  tft.setCursor(0, 0);
  tft.println(" \n\n Waiting\n for\n finger...");
  int id = getFingerprintID();
  if (id == -1) {
    tft.fillScreen(RED);
    tft.println(" No\n Match\n Found\n\n");
    delay(1000);
  } else {
    tft.fillScreen(GREEN);
    tft.print(" ID\n Found:\n ");
    tft.println(id);
    delay(1000);
  }
  delay(3000); // Pause before next scan
}

int getFingerprintID() {
  int result = FINGERPRINT_NOFINGER;  // Initialize with a non-success value

  // Poll until a valid fingerprint is detected
  while (result != FINGERPRINT_OK) {
    result = finger.getImage();
    if (result == FINGERPRINT_OK) break;  // If a valid image is found, exit the loop
    if (result == FINGERPRINT_NOFINGER) {
      // Optionally, you can add a delay here to avoid busy-waiting, e.g., delay(100);
      continue;  // No finger detected, try again
    }
    return -1;  // If there's an error, return -1
  }

  // Process the image and search for the fingerprint
  result = finger.image2Tz();
  if (result != FINGERPRINT_OK) return -1;

  result = finger.fingerFastSearch();
  if (result != FINGERPRINT_OK) return -1;

  return finger.fingerID;
}

/*
Wiring Guide:

1. Fingerprint Sensor:
   - Vtouch (Blue)  -> 3.3V (Power for touch sensor) Don't really need to wire this 
   - Vin (Red)      -> 3.3V (Power input)
   - Sout (Yellow)  -> Not Used                      Don't really need to wire this
   - TD (Green)     -> GPIO 16 (RX_PIN, Data Output)
   - RD (White)     -> GPIO 17 (TX_PIN, Data Input)
   - GND (Black)    -> GND

2. TFT Display:
   - VCC (Red)      -> 3.3V (Power input)
   - GND (Black)    -> GND
   - CS             -> GPIO 15 (__CS)
   - DC/A0          -> GPIO 2 (__DC)
   - RESET          -> GPIO 4 (A0)
   - SDA (MOSI)     -> GPIO 23 (SPI MOSI)
   - SCK (Clock)    -> GPIO 18 (SPI SCK)
   - LED (Backlight)-> 3.3V (Power input for backlight)
*/
